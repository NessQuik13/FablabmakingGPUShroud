#include <Arduino.h>
#include <Wire.h>
#include <Adafruit_GFX.h>
#include <Adafruit_SSD1306.h>
#define SCREEN_WIDTH 128
#define SCREEN_HEIGHT 64

Adafruit_SSD1306 display(SCREEN_WIDTH, SCREEN_HEIGHT, &Wire, -1);
String inputString = "";
boolean stringComplete = false;
String gpuTemp = "0";
String gpuFanSpeed = "0";

int i = 0;
int j = 0;
unsigned long prevMillis = 0;
unsigned long interval = 50;

//frames fan animation
const unsigned char PROGMEM fanGIF [][72] = {{0x00, 0x00, 0x00, 0x1F, 0xFF, 0xF8, 0x3F, 0xFF, 0xFC, 0x67, 0xFF, 0xE6, 0x67,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 0x00, 0x00},
                                             {0x00, 0x00, 0x00, 0x1F, 0xFF, 0xF8, 0x3F, 0xFF, 0xFC, 0x67, 0xFF, 0xE6, 0x67,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 0x00, 0x00},
                                             {0x00, 0x00, 0x00, 0x1F, 0xFF, 0xF8, 0x3F, 0xFF, 0xFC, 0x67, 0xFF, 0xE6, 0x67,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 0x00, 0x00},
                                             {0x00, 0x00, 0x00, 0x1F, 0xFF, 0xF8, 0x3F, 0xFF, 0xFC, 0x67, 0xFF, 0xE6, 0x67,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 0x00, 0x00}
                                            };
//frames temp animation
const unsigned char PROGMEM tempGIF[][72] = {{0x00, 0x00, 0x00, 0x00, 0x30, 0x00, 0x00, 0x7C, 0x00, 0x00, 0xCC, 0x00, 0x00,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 0x00, 0x00},
                                             {0x00, 0x00, 0x00, 0x00, 0x30, 0x00, 0x00, 0x7C, 0x00, 0x00, 0xCC, 0x00, 0x00,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 0x00, 0x00},
                                             {0x00, 0x00, 0x00, 0x00, 0x30, 0x00, 0x00, 0x7C, 0x00, 0x00, 0xCC, 0x00, 0x00,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 0x00, 0x00},
                                             {0x00, 0x00, 0x00, 0x00, 0x30, 0x00, 0x00, 0x7C, 0x00, 0x00, 0xCC, 0x00, 0x00,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 0x00, 0x00}
                                            };

void parseData(String);
void displayUpdate(String temp, String fan);

void setup() {
  // put your setup code here, to run once:
  Serial.begin(115200);
  if(!display.begin(SSD1306_SWITCHCAPVCC, 0x3C)){
    Serial.println("Display allocation failed");
  }
  display.clearDisplay();
  display.setTextColor(WHITE);
  display.setTextSize(2);
}

void loop() {
  // put your main code here, to run repeatedly:
  if (stringComplete){
    if (inputString.equals("Start")){
      Serial.write("Started\n");
      stringComplete = false;
      inputString = "";
      return;
    }
      parseData(inputString);
      displayUpdate(gpuTemp, gpuFanSpeed);
      stringComplete = false;
      inputString = "";
  }
  unsigned long currentMillis = millis();
  if (currentMillis - prevMillis > interval){
    displayUpdate(gpuTemp, gpuFanSpeed);
    i++;
  }
  if (currentMillis - prevMillis > interval*2){
    displayUpdate(gpuTemp, gpuFanSpeed);
    i++;
    j++;
    prevMillis = currentMillis;
  }



}
// als er een input van de pc komt zorgt deze functie dat de string die binnen komt word gelezen en opgeslagen. 
void serialEvent(){
  while (Serial.available()){
    char inChar = (char)Serial.read();
    if (inChar == '\n'){
      stringComplete = true;
      return;
    }
    inputString += inChar;
  }
}
// gets the right data out of the recieved string and stores it in variables
void parseData(String data){
  String temp = data.substring(0, data.indexOf("-"));
  gpuTemp = temp;
  temp = data.substring(data.indexOf("-") + 1, data.indexOf("="));
  gpuFanSpeed = temp;
}

// prints values op de display
void displayUpdate(String temp, String fan){
  display.clearDisplay();
  display.drawBitmap(0, 3,tempGIF[j],24,24, 1);
  display.setCursor(30, 3);
  display.print(gpuTemp);
  display.drawBitmap(0, 30, fanGIF[i], 24, 24,1);
  display.setCursor(30, 30);
  display.print(gpuFanSpeed);
  display.display();
  if (i > 2){
    i = 0;
  }
  if (j > 2){
    j = 0;
  }
}
